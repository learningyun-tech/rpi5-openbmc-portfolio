## meta-rpi5-openbmc/conf/layer.conf
```bitbake
BBPATH .= ":${LAYERDIR}"

BBFILES += "${LAYERDIR}/recipes-*/*/*.bb \
            ${LAYERDIR}/recipes-*/*/*.bbappend"

BBFILE_COLLECTIONS += "rpi5-openbmc-lab"
BBFILE_PATTERN_rpi5-openbmc-lab = "^${LAYERDIR}/"
BBFILE_PRIORITY_rpi5-openbmc-lab = "12"

LAYERDEPENDS_rpi5-openbmc-lab = "core phosphor-layer raspberrypi"
LAYERSERIES_COMPAT_rpi5-openbmc-lab = "wrynose"
```
